## CMakeLists.txt
```
# SPDX-License-Identifier: Apache-2.0
#
# Copyright (c) Centro de Inovacao EDGE

cmake_minimum_required(VERSION 3.20.0)

find_package(Zephyr REQUIRED HINTS $ENV{ZEPHYR_BASE})
project(bringup_p2)

# One test per on-board module, plus the shared menu layer, all in this one
# application. New src/mod_*.c files are picked up with no edit here --
# CONFIGURE_DEPENDS is what makes that true without a pristine build, since a
# plain glob is evaluated once and then cached.
file(GLOB app_sources CONFIGURE_DEPENDS src/*.c)
target_sources(app PRIVATE ${app_sources})

target_include_directories(app PRIVATE include)
```

## Kconfig
```
# Application options for the ZBook P2 bring-up menu.
#
# SPDX-License-Identifier: Apache-2.0
# Copyright (c) Centro de Inovacao EDGE

mainmenu "ZBook P2 bring-up"

config BRINGUP_SNTP_SERVER
	string "SNTP server used to set the clock"
	default "pool.ntp.org"
	help
	  Queried once the device comes online, and periodically after that.
	  Resolved by name, so the build needs DNS_RESOLVER (the zbook_wifi
	  shield turns it on).

config BRINGUP_SNTP_TIMEOUT_MS
	int "How long to wait for an SNTP reply"
	default 8000
	help
	  A failed query is retried on a shorter interval than a successful one.

config BRINGUP_SNTP_RESYNC_MINUTES
	int "Minutes between successful re-syncs"
	default 60
	help
	  This board has no RTC, so the wall clock is the kernel uptime plus an
	  offset and drifts with the system clock. Re-syncing hourly keeps the
	  displayed minute honest.

config BRINGUP_UTC_OFFSET_MINUTES
	int "Minutes to add to UTC for the displayed clock"
	default -180
	help
	  SNTP reports UTC. There is no timezone database here, so the title bar
	  clock just adds this fixed offset. The default is -180, i.e. UTC-3
	  (Brasilia, which has had no DST since 2019). Change it for your
	  location.

source "Kconfig.zephyr"
```

## prj.conf
```kconfig
# ---- Kernel ----------------------------------------------------------------
# LVGL's timer handler runs on the main thread and the widget tree is built
# there too, so main needs more than the default 1 KiB.
CONFIG_MAIN_STACK_SIZE=4096
CONFIG_HEAP_MEM_POOL_SIZE=8192

CONFIG_LOG=y
CONFIG_LOG_MODE_MINIMAL=y

# Required for LVGL's own sanity checks to do anything: the Zephyr glue maps
# LV_ASSERT_HANDLER onto __ASSERT_NO_MSG(), which compiles away without this.
# Notably LV_ASSERT_MALLOC -- without CONFIG_ASSERT an exhausted LVGL heap
# hands out a half-built object and the fault surfaces later, somewhere else,
# as a bus error on a garbage style pointer.
CONFIG_ASSERT=y

# ---- Display: SSD1306 128x64 mono OLED on i2c0 -----------------------------
# The panel is picked up from the board's `chosen { zephyr,display = &oled; }`.
CONFIG_I2C=y
CONFIG_DISPLAY=y
CONFIG_SSD1306=y

# ---- Input: rotary encoder (gpio-qdec) + buttons (gpio-keys) ---------------
# The buttons feed the Buttons/Enc screen through the input subsystem rather
# than being read as GPIOs, so what it shows is what the input layer reports.
CONFIG_INPUT=y
CONFIG_INPUT_GPIO_QDEC=y
CONFIG_INPUT_GPIO_KEYS=y

# ---- The rest of the board -------------------------------------------------
CONFIG_ADC=y

CONFIG_PWM=y
CONFIG_PWM_RPI_PICO=y

CONFIG_LED_STRIP=y
CONFIG_WS2812_STRIP_RPI_PICO_PIO=y

CONFIG_SPI=y

CONFIG_SENSOR=y
CONFIG_TMP1075=y
CONFIG_BMI323=y

# ---- LVGL ------------------------------------------------------------------
CONFIG_LVGL=y

# 1 bpp rendering. The panel is column-major ("vtiled"), 8 rows per page; the
# Zephyr LVGL glue rounds every redraw area to those page boundaries and packs
# the bits in lvgl_display_mono.c, so nothing here has to know about it.
CONFIG_LV_COLOR_DEPTH_1=y
# The SSD1306 inverts in hardware (display_set_pixel_format), so LVGL can skip
# doing it in software.
CONFIG_LV_Z_COLOR_MONO_HW_INVERSION=y
# A whole 128x64 1bpp frame is only 1 KiB, so render the full screen at once
# instead of tile by tile -- simpler and no partial-refresh tearing.
CONFIG_LV_Z_VDB_SIZE=100
CONFIG_LV_DPI_DEF=110

# Every screen is built up front and kept, so the pool has to hold all twelve
# at once. Measured with `lvgl stats memory` in the debug build: 34 KiB
# allocated, so this leaves a bit under half spare for a few more modules.
# Do not shave it close -- running out is not graceful, it hands out a
# half-built widget (see CONFIG_ASSERT above).
CONFIG_LV_Z_MEM_POOL_SIZE=65536

# UNSCII 8 is a crisp 1 bpp bitmap font: no anti-aliasing to threshold away,
# and it lays the screen out as an exact 16x8 character grid.
CONFIG_LV_FONT_UNSCII_8=y
CONFIG_LV_FONT_DEFAULT_UNSCII_8=y

# The widgets used (label, button, bar, flex layout) are all on by default, as
# is LV_USE_THEME_MONO -- LVGL picks the monochrome theme automatically at
# 1 bpp, which is why nothing here selects a theme. Turning the unused widgets
# off is the first place to look if the image needs to shrink.
```

## debug.conf
```kconfig
# Diagnostic overlay: adds an interactive shell on the console UART, for when
# a module misbehaves and the menu alone is not enough.
#
#   just run-debug
#
#   i2c scan i2c0        # ssd1306 answers at 0x3c, tmp1075 would at 0x48
#   device list          # every driver's probe result, in one place
#   input dump on        # raw input events: buttons and encoder
#   lvgl stats           # LVGL heap use -- check before trimming the pool size
#   cfb init && cfb invert
#                        # drives the panel with display_write() directly, so a
#                        # blank screen here means panel or driver, and a blank
#                        # screen only under LVGL means LVGL
#
# Verbose logging as well. The i2c driver's DBG output is per-transfer and
# drowns everything else, so it stays at ERR.

CONFIG_SHELL=y
CONFIG_SHELL_STACK_SIZE=4096

CONFIG_I2C_SHELL=y
CONFIG_INPUT_SHELL=y
CONFIG_DEVICE_SHELL=y
CONFIG_SENSOR_SHELL=y
CONFIG_LV_Z_SHELL=y

CONFIG_CHARACTER_FRAMEBUFFER=y
CONFIG_CHARACTER_FRAMEBUFFER_SHELL=y

CONFIG_LOG_MODE_MINIMAL=n
CONFIG_I2C_LOG_LEVEL_ERR=y
CONFIG_DISPLAY_LOG_LEVEL_DBG=y
```

## wifi.conf
```kconfig
# Applied on top of prj.conf for the Wi-Fi build, which is the only one where
# these symbols have their dependencies met:
#
#   west build -b zbook@p2/rp2350b/m33 samples/bringup_p2 \
#       --shield zbook_wifi -S zbook-wifi-credentials-littlefs \
#       -- -DEXTRA_CONF_FILE=wifi.conf
#
# The snippet is what puts the credentials in flash (settings on LittleFS at
# /lfs, on the board's `storage` partition). Store them once from the shell:
#
#   wifi cred add -s <SSID> -p <PSK> -k 1
#   wifi cred auto_connect
#
# They survive a reboot and a reflash of the application, and never appear in
# the source tree.

# Connect on boot using whatever is in flash, so "goes online" needs no
# intervention after the one-time `wifi cred add`.
CONFIG_WIFI_CREDENTIALS_CONNECT_STORED=y
CONFIG_WIFI_CREDENTIALS_SHELL=y

# Clock from SNTP once the link comes up. NET_CONNECTION_MANAGER (on by default
# from the shield) is what raises the L4-connected event this hangs off.
CONFIG_SNTP=y
CONFIG_NET_SOCKETS=y
CONFIG_DNS_RESOLVER=y

# A DNS server has to be configured statically here. The ESP8266 offloads the
# IP stack and runs its own DHCP client, so the lease -- address, gateway and
# the DNS servers with it -- is negotiated inside the module and never reaches
# Zephyr's resolver. `net dns` then lists no servers and every name lookup
# fails with -EAGAIN, which is what SNTP reports. The esp_at driver offloads
# sockets but not getaddrinfo, so nothing else picks up the slack.
#
# A public resolver rather than the gateway, so this works on any network.
# Change it to your own if you would rather not talk to Google.
CONFIG_DNS_SERVER_IP_ADDRESSES=y
CONFIG_DNS_SERVER1="8.8.8.8:53"
```

## app.overlay
```dts
/**
 * @file app.overlay
 * @brief Wires the ZBook P2 rotary encoder into LVGL.
 *
 *        The board describes the encoder as two independent Zephyr input
 *        devices -- `encoder_qdec` (gpio-qdec, emits INPUT_REL_WHEEL) and
 *        `enc_button` (gpio-keys, emits INPUT_KEY_ENTER). LVGL wants a single
 *        encoder indev, so this pseudo-device merges them: with no `input`
 *        phandle it subscribes to every input device in the system and keeps
 *        the two codes below, ignoring the rest (the four user buttons).
 *
 *        P2 only -- the P1 revision has no encoder.
 *
 * @copyright Copyright (c) Centro de Inovacao EDGE
 */

#include <zephyr/dt-bindings/input/input-event-codes.h>

/ {
	lvgl_encoder_input {
		compatible = "zephyr,lvgl-encoder-input";
		rotation-input-code = <INPUT_REL_WHEEL>;
		button-input-code = <INPUT_KEY_ENTER>;
	};
};
```

## src/main.c
```c
/**
 * @file main.c
 * @brief bringup -- one application that exercises every module on the ZBook
 *        P2, presented as an encoder-driven menu on the on-board OLED.
 *
 *        Board target: zbook@p2/rp2350b/m33. Add --shield zbook_wifi to
 *        include the Wi-Fi screen; everything else is on the board itself.
 *
 * @copyright Copyright (c) Centro de Inovacao EDGE
 */

#include "clock_sync.h"
#include "module.h"

#include <lvgl.h>
#include <zephyr/device.h>
#include <zephyr/devicetree.h>
#include <zephyr/drivers/display.h>
#include <zephyr/kernel.h>
#include <zephyr/logging/log.h>

LOG_MODULE_REGISTER(main, LOG_LEVEL_INF);

#if !DT_NODE_EXISTS(DT_NODELABEL(encoder_qdec))
#error "bringup needs the ZBook P2 encoder: build with -b zbook@p2/rp2350b/m33"
#endif

/* Cap on how long the loop may sleep between lv_timer_handler() calls. LVGL
 * returns LV_NO_TIMER_READY (UINT32_MAX) when it has nothing pending, which
 * would otherwise park the thread indefinitely.
 */
#define LVGL_MAX_SLEEP_MS 50

int main(void)
{
	int ret;
	const struct device *display_dev = DEVICE_DT_GET(DT_CHOSEN(zephyr_display));

	if (!device_is_ready(display_dev)) {
		LOG_ERR("Display %s is not ready", display_dev->name);
		return -ENODEV;
	}

	ret = menu_init();
	if (ret < 0) {
		LOG_ERR("Failed to build the menu (%d)", ret);
		return ret;
	}

	/* Asks Wi-Fi to connect with the credentials in flash, then sets the
	 * clock from SNTP once the link comes up. A no-op without networking.
	 */
	clock_sync_init();

	/* Render the first frame before unblanking so the panel never shows the
	 * controller's power-on garbage.
	 */
	lv_timer_handler();
	display_blanking_off(display_dev);

	LOG_INF("Turn the encoder to move, press to select");

	while (true) {
		uint32_t next_ms = lv_timer_handler();

		k_msleep(MIN(next_ms, LVGL_MAX_SLEEP_MS));
	}

	return 0;
}
```

## include/clock_sync.h
```c
/**
 * @file clock_sync.h
 * @brief Wall clock from SNTP, for the title bar.
 *
 *        This board has no RTC, so the wall clock is the kernel's monotonic
 *        time plus an offset that SNTP establishes once the device comes
 *        online. Nothing here is available in a build without networking; the
 *        clock then simply never becomes valid and the title bar stays clear
 *        of it.
 *
 * @copyright Copyright (c) Centro de Inovacao EDGE
 */

#ifndef BRINGUP_CLOCK_SYNC_H_
#define BRINGUP_CLOCK_SYNC_H_

#include <stdbool.h>
#include <stddef.h>

/**
 * @brief Start watching for the device coming online.
 *
 * On a build with networking this asks Wi-Fi to connect using the credentials
 * stored in flash, then syncs from SNTP whenever the link comes up and
 * periodically after that. On a build without, it does nothing.
 */
void clock_sync_init(void);

/**
 * @brief Whether the clock has been set at least once.
 *
 * @return False until the first successful SNTP query.
 */
bool clock_sync_is_valid(void);

/**
 * @brief Format the current local time as "HH:MM".
 *
 * @param[out] buffer Receives the text, or an empty string if the clock has
 *                    never been set.
 * @param      size   Size of @p buffer. Six bytes is enough.
 *
 * @return True if a time was written.
 */
bool clock_sync_format(char *buffer, size_t size);

/**
 * @brief One-line sync state, for a status display.
 *
 * @return A string such as "synced", "no link" or "not in build". Never NULL.
 */
const char *clock_sync_state(void);

#endif /* BRINGUP_CLOCK_SYNC_H_ */
```

## include/module.h
```c
/**
 * @file module.h
 * @brief The interface every hardware module in the bring-up menu implements.
 *
 *        One application covers the whole board: each on-board module
 *        contributes one entry to the table in menu.c, which builds one row on
 *        the home screen and one screen behind it. A single LVGL timer drives
 *        the refresh of whichever screen is showing, so a module that displays
 *        live values only has to fill in @ref bringup_module.refresh.
 *
 * @copyright Copyright (c) Centro de Inovacao EDGE
 */

#ifndef BRINGUP_MODULE_H_
#define BRINGUP_MODULE_H_

#include <stdbool.h>

#include <oled_menu.h>

/** One on-board hardware module, as presented in the menu. */
struct bringup_module {
	/** Home-screen row text. At most @ref OLED_MENU_COLUMNS characters. */
	const char *label;

	/**
	 * @brief Build this module's screen.
	 *
	 * @param home Screen its "< Back" row must return to.
	 *
	 * @retval 0 on success, negative errno otherwise.
	 */
	int (*create)(const struct oled_menu_screen *home);

	/**
	 * @brief This module's entry screen, valid once create() succeeded.
	 *
	 * Selecting the module's row shows this one. A module with a submenu
	 * returns the submenu here and reports its sub-screens through
	 * is_showing().
	 */
	const struct oled_menu_screen *(*screen)(void);

	/**
	 * @brief Whether any screen belonging to this module is on display.
	 *
	 * Only needed by a module that owns more than the one screen(): the
	 * refresh below is driven off this. NULL means "just screen()".
	 *
	 * @return True if one of this module's screens is showing.
	 */
	bool (*is_showing)(void);

	/**
	 * @brief Re-read the hardware and update the widgets.
	 *
	 * Called periodically, only while this module's screen is showing.
	 * NULL for a module with nothing live to show.
	 */
	void (*refresh)(void);

	/**
	 * @brief Whether the hardware this module tests is actually there.
	 *
	 * Checked once, after create(). A module that reports false keeps its
	 * menu row and its screen, but the row is struck through. NULL for a
	 * module that is always present, such as the LEDs.
	 *
	 * @return False if the device did not probe.
	 */
	bool (*present)(void);
};

/* The modules, in the order they appear on the home screen. */
extern const struct bringup_module module_leds;
extern const struct bringup_module module_buttons;
extern const struct bringup_module module_strip;
extern const struct bringup_module module_buzzer;
extern const struct bringup_module module_analog;
extern const struct bringup_module module_sense;
extern const struct bringup_module module_ir;
extern const struct bringup_module module_temp;
extern const struct bringup_module module_accel;
extern const struct bringup_module module_display;
extern const struct bringup_module module_wifi;
extern const struct bringup_module module_about;

/**
 * @brief Build the home screen and every module screen behind it.
 *
 * @retval 0 on success.
 * @retval -ENODEV if LVGL has no encoder input device.
 * @retval -ENOMEM if a screen could not be allocated.
 */
int menu_init(void);

#endif /* BRINGUP_MODULE_H_ */
```

## include/oled_menu.h
```c
/**
 * @file oled_menu.h
 * @brief A small encoder-driven menu layer for the ZBook's 128x64 monochrome
 *        OLED, shared by the samples under samples/oled/.
 *
 *        The look is fixed by the panel: an inverted 9 px title bar over rows
 *        of 10 px, sized against the UNSCII 8 font (which makes the screen an
 *        exact 16x8 character grid). Focus is drawn as a full row inversion,
 *        because a 1 px outline is easy to miss at 1 bpp.
 *
 *        Navigation is LVGL's own: every focusable row on a screen joins that
 *        screen's lv_group_t, and the encoder is pointed at the group of
 *        whichever screen is showing. Rotating moves the focus, pressing sends
 *        LV_EVENT_CLICKED to the focused row.
 *
 * @copyright Copyright (c) Centro de Inovacao EDGE
 */

#ifndef OLED_MENU_H_
#define OLED_MENU_H_

#include <stdbool.h>
#include <stdint.h>

#include <lvgl.h>

/** Height of the inverted title bar, in pixels. */
#define OLED_MENU_TITLE_HEIGHT_PX 9

/** Height of one focusable row, in pixels. */
#define OLED_MENU_ROW_HEIGHT_PX 10

/** Characters that fit across the screen in the UNSCII 8 font. */
#define OLED_MENU_COLUMNS 16

/** How the content area below the title bar arranges its children. */
enum oled_menu_layout {
	/** Rows packed from the top; scrolls when they overflow. */
	OLED_MENU_LAYOUT_LIST,
	/** Children centred; for a value plus a bar plus a back row. */
	OLED_MENU_LAYOUT_PANEL,
};

/** One screen, its focus group, and the area widgets are added to. */
struct oled_menu_screen {
	/** The LVGL screen object. */
	lv_obj_t *screen;
	/** Content area below the title bar; parent of everything added. */
	lv_obj_t *content;
	/** Title text, at the left of the title bar. */
	lv_obj_t *title;
	/** Clock text, right-aligned in the title bar. Empty until set. */
	lv_obj_t *clock;
	/** Focus group the encoder is pointed at while this screen shows. */
	lv_group_t *group;
};

/**
 * @brief Initialise the shared styles and find the encoder input device.
 *
 * Call once, from the thread that will pump lv_timer_handler(). Any LVGL
 * encoder input device registered by the devicetree is used; the node's label
 * does not matter.
 *
 * @retval 0 on success.
 * @retval -ENODEV if LVGL has no encoder input device.
 */
int oled_menu_init(void);

/**
 * @brief Build an empty screen with an inverted title bar.
 *
 * @param[out] screen Filled in on success.
 * @param      title  Title bar text, at most @ref OLED_MENU_COLUMNS characters.
 * @param      layout How the content area arranges its children.
 *
 * @retval 0 on success.
 * @retval -ENOMEM if LVGL could not allocate the screen or its group.
 */
int oled_menu_screen_create(struct oled_menu_screen *screen, const char *title,
			    enum oled_menu_layout layout);

/**
 * @brief Replace a screen's title bar text.
 *
 * @param screen Screen to retitle.
 * @param title  New text.
 */
void oled_menu_screen_set_title(struct oled_menu_screen *screen, const char *title);

/**
 * @brief Show a screen and point the encoder at its focus group.
 *
 * @param screen Screen to display.
 */
void oled_menu_show(const struct oled_menu_screen *screen);

/**
 * @brief Set the text shown at the right of the title bar.
 *
 * Only the visible screen is written; the text is remembered and re-applied by
 * oled_menu_show(), so it does not blink when screens change. Titles have to
 * leave room for it: the bar is @ref OLED_MENU_COLUMNS characters wide in
 * total.
 *
 * @param text Text to show, or "" to clear it.
 */
void oled_menu_clock_set(const char *text);

/**
 * @brief Whether a screen is the one currently on the display.
 *
 * Lets a periodic refresh update only the visible screen.
 *
 * @param screen Screen to test.
 *
 * @return True if @p screen is active.
 */
bool oled_menu_is_active(const struct oled_menu_screen *screen);

/**
 * @brief Add a focusable row to a screen.
 *
 * @param screen    Screen to add to.
 * @param text      Row text.
 * @param on_click  Called on LV_EVENT_CLICKED, i.e. an encoder press. May be
 *                  NULL for a row that only displays something.
 * @param user_data Passed to @p on_click as the event user data.
 *
 * @return The row widget, or NULL on allocation failure.
 */
lv_obj_t *oled_menu_row_add(struct oled_menu_screen *screen, const char *text,
			    lv_event_cb_t on_click, void *user_data);

/**
 * @brief Add a "< Back" row that shows @p target when pressed.
 *
 * @param screen Screen to add the row to.
 * @param target Screen to return to. Must outlive @p screen.
 *
 * @return The row widget, or NULL on allocation failure.
 */
lv_obj_t *oled_menu_back_row_add(struct oled_menu_screen *screen,
				 const struct oled_menu_screen *target);

/**
 * @brief Replace a row's text.
 *
 * @param row  Row returned by oled_menu_row_add().
 * @param text New text.
 */
void oled_menu_row_set_text(lv_obj_t *row, const char *text);

/**
 * @brief Replace a row's text from a printf-style format.
 *
 * @param row Row returned by oled_menu_row_add().
 * @param fmt Format string, then its arguments.
 */
void oled_menu_row_set_text_fmt(lv_obj_t *row, const char *fmt, ...);

/**
 * @brief Mark a row as referring to hardware that is not present.
 *
 * The row stays in the list and stays selectable -- opening it is how you see
 * why -- but its text is struck through so an absent module is obvious from
 * the menu itself.
 *
 * @param row    Row returned by oled_menu_row_add().
 * @param absent True to strike the text through, false to clear it.
 */
void oled_menu_row_set_absent(lv_obj_t *row, bool absent);

/**
 * @brief Add a plain, non-focusable label.
 *
 * Update it afterwards with lv_label_set_text() or lv_label_set_text_fmt().
 *
 * @param screen Screen to add to.
 * @param text   Initial text.
 *
 * @return The label, or NULL on allocation failure.
 */
lv_obj_t *oled_menu_label_add(struct oled_menu_screen *screen, const char *text);

/**
 * @brief Add a horizontal progress bar, 120 px wide.
 *
 * Update it afterwards with lv_bar_set_value().
 *
 * @param screen Screen to add to.
 * @param min    Value at empty.
 * @param max    Value at full.
 *
 * @return The bar, or NULL on allocation failure.
 */
lv_obj_t *oled_menu_bar_add(struct oled_menu_screen *screen, int32_t min, int32_t max);

#endif /* OLED_MENU_H_ */
```

## src/clock_sync.c
```c
/**
 * @file clock_sync.c
 * @brief Sets the wall clock from SNTP when the device comes online.
 *
 * @copyright Copyright (c) Centro de Inovacao EDGE
 */

#include "clock_sync.h"

#include <time.h>

#include <zephyr/kernel.h>
#include <zephyr/logging/log.h>
#include <zephyr/sys/clock.h>

LOG_MODULE_REGISTER(clock_sync, LOG_LEVEL_INF);

#ifdef CONFIG_SNTP

#include <errno.h>

#include <zephyr/net/net_event.h>
#include <zephyr/net/net_if.h>
#include <zephyr/net/net_mgmt.h>
#include <zephyr/net/sntp.h>
#include <zephyr/net/wifi_mgmt.h>

/* A failed query is worth retrying soon; a successful one holds for an hour. */
#define RETRY_DELAY  K_SECONDS(20)
#define RESYNC_DELAY K_MINUTES(CONFIG_BRINGUP_SNTP_RESYNC_MINUTES)

/* Long enough for the ESP-AT link to finish associating and get a DHCP lease
 * before the first query goes out.
 */
#define FIRST_QUERY_DELAY K_SECONDS(2)

/* The query runs on a queue of its own rather than the system workqueue, for
 * two reasons: name resolution plus a socket needs far more stack than the
 * system queue's default 1 KiB (it overflows and faults), and a query that
 * times out blocks its thread for the whole timeout, which is not something to
 * inflict on a queue the rest of the system shares.
 */
#define SNTP_STACK_SIZE 4096
#define SNTP_PRIORITY   K_PRIO_PREEMPT(10)

static K_THREAD_STACK_DEFINE(sntp_stack, SNTP_STACK_SIZE);
static struct k_work_q sntp_workq;

static struct net_mgmt_event_callback l4_cb;
static struct k_work_delayable sync_work;

static bool link_up;
static bool valid;

static void sync_handler(struct k_work *work)
{
	int ret;
	struct sntp_time sntp;
	struct timespec wall;

	ARG_UNUSED(work);

	if (!link_up) {
		return;
	}

	/* sntp_simple() blocks on a socket, which is why this runs on a
	 * workqueue rather than straight from the net_mgmt callback.
	 */
	ret = sntp_simple(CONFIG_BRINGUP_SNTP_SERVER, CONFIG_BRINGUP_SNTP_TIMEOUT_MS, &sntp);
	if (ret < 0) {
		/* -EAGAIN here is usually name resolution, not the NTP server:
		 * check `net dns` lists a server.
		 */
		LOG_WRN("%s: no time (%d), retrying", CONFIG_BRINGUP_SNTP_SERVER, ret);
		k_work_reschedule_for_queue(&sntp_workq, &sync_work, RETRY_DELAY);
		return;
	}

	wall.tv_sec = (time_t)sntp.seconds;
	wall.tv_nsec = 0;

	ret = sys_clock_settime(SYS_CLOCK_REALTIME, &wall);
	if (ret < 0) {
		LOG_ERR("could not set the clock (%d)", ret);
		k_work_reschedule_for_queue(&sntp_workq, &sync_work, RETRY_DELAY);
		return;
	}

	valid = true;
	LOG_INF("clock set from %s: %llu", CONFIG_BRINGUP_SNTP_SERVER,
		(unsigned long long)sntp.seconds);

	k_work_reschedule_for_queue(&sntp_workq, &sync_work, RESYNC_DELAY);
}

static void on_l4_event(struct net_mgmt_event_callback *cb, uint64_t event, struct net_if *iface)
{
	ARG_UNUSED(cb);
	ARG_UNUSED(iface);

	switch (event) {
	case NET_EVENT_L4_CONNECTED:
		LOG_INF("online, syncing the clock");
		link_up = true;
		k_work_reschedule_for_queue(&sntp_workq, &sync_work, FIRST_QUERY_DELAY);
		break;
	case NET_EVENT_L4_DISCONNECTED:
		LOG_INF("offline");
		link_up = false;
		/* The time already set stays valid and keeps ticking off the
		 * kernel clock; only re-syncing has to wait for the link.
		 */
		break;
	default:
		break;
	}
}

void clock_sync_init(void)
{
	const struct k_work_queue_config config = {
		.name = "sntp",
	};

	k_work_queue_start(&sntp_workq, sntp_stack, K_THREAD_STACK_SIZEOF(sntp_stack),
			   SNTP_PRIORITY, &config);

	k_work_init_delayable(&sync_work, sync_handler);

	net_mgmt_init_event_callback(&l4_cb, on_l4_event,
				     NET_EVENT_L4_CONNECTED | NET_EVENT_L4_DISCONNECTED);
	net_mgmt_add_event_callback(&l4_cb);

#ifdef CONFIG_WIFI_CREDENTIALS_CONNECT_STORED
	{
		int ret;
		struct net_if *iface = net_if_get_first_wifi();

		if (iface == NULL) {
			LOG_WRN("no Wi-Fi interface to connect");
			return;
		}

		/* Uses whatever `wifi cred add` put in flash. Absent
		 * credentials are not an error worth shouting about: the board
		 * is then simply offline and the title bar carries no clock.
		 */
		ret = net_mgmt(NET_REQUEST_WIFI_CONNECT_STORED, iface, NULL, 0);
		if (ret < 0) {
			LOG_INF("no stored credentials to connect with (%d)", ret);
		}
	}
#endif /* CONFIG_WIFI_CREDENTIALS_CONNECT_STORED */
}

const char *clock_sync_state(void)
{
	if (valid) {
		return "synced";
	}

	return link_up ? "syncing" : "no link";
}

#else /* !CONFIG_SNTP */

static const bool valid;

void clock_sync_init(void)
{
	/* No networking in this build, so there is nothing to sync against. */
}

const char *clock_sync_state(void)
{
	return "not in build";
}

#endif /* CONFIG_SNTP */

bool clock_sync_is_valid(void)
{
	return valid;
}

bool clock_sync_format(char *buffer, size_t size)
{
	struct timespec now;
	struct tm parts;
	time_t local;

	if (!valid) {
		if (size > 0) {
			buffer[0] = '\0';
		}
		return false;
	}

	if (sys_clock_gettime(SYS_CLOCK_REALTIME, &now) < 0) {
		if (size > 0) {
			buffer[0] = '\0';
		}
		return false;
	}

	/* SNTP hands out UTC and there is no timezone database here, so the
	 * offset is applied to the epoch seconds and the result read back with
	 * gmtime_r -- localtime_r would apply nothing on top of it anyway.
	 */
	local = (time_t)now.tv_sec + (CONFIG_BRINGUP_UTC_OFFSET_MINUTES * 60);

	if (gmtime_r(&local, &parts) == NULL) {
		if (size > 0) {
			buffer[0] = '\0';
		}
		return false;
	}

	snprintk(buffer, size, "%02d:%02d", parts.tm_hour, parts.tm_min);

	return true;
}
```

## src/menu.c
```c
/**
 * @file menu.c
 * @brief The home screen: one row per on-board module, and the timer that
 *        refreshes whichever module screen is showing.
 *
 * @copyright Copyright (c) Centro de Inovacao EDGE
 */

#include "clock_sync.h"
#include "module.h"

#include <errno.h>
#include <stddef.h>

#include <zephyr/logging/log.h>

LOG_MODULE_REGISTER(menu, LOG_LEVEL_INF);

/** Fast enough to feel live on a button press, slow enough not to flicker. */
#define REFRESH_PERIOD_MS 100

/** The title bar only shows minutes, so once a second is plenty. */
#define CLOCK_PERIOD_MS 1000

/* Every module is listed unconditionally, including hardware that may not be
 * fitted: a row struck through is more useful than a row that is not there.
 */
static const struct bringup_module *const modules[] = {
	&module_leds,   &module_buttons, &module_strip, &module_buzzer,
	&module_analog, &module_sense,   &module_ir,    &module_temp,
	&module_accel,  &module_display, &module_wifi,  &module_about,
};

static struct oled_menu_screen home;

static void on_open_module(lv_event_t *event)
{
	const struct bringup_module *module = lv_event_get_user_data(event);

	oled_menu_show(module->screen());
}

static void clock_timer_cb(lv_timer_t *timer)
{
	char text[8];

	ARG_UNUSED(timer);

	/* Empty until SNTP has set the clock, which leaves the title bar to
	 * the title alone rather than showing a placeholder time.
	 */
	(void)clock_sync_format(text, sizeof(text));
	oled_menu_clock_set(text);
}

static void refresh_timer_cb(lv_timer_t *timer)
{
	ARG_UNUSED(timer);

	for (size_t i = 0; i < ARRAY_SIZE(modules); i++) {
		if (modules[i]->refresh == NULL) {
			continue;
		}

		/* A module with a submenu knows which of its screens is up;
		 * everything else is just its one screen.
		 */
		if (modules[i]->is_showing != NULL ? modules[i]->is_showing()
						   : oled_menu_is_active(modules[i]->screen())) {
			modules[i]->refresh();
			return;
		}
	}
}

int menu_init(void)
{
	int ret;

	ret = oled_menu_init();
	if (ret < 0) {
		return ret;
	}

	ret = oled_menu_screen_create(&home, "ZBook P2", OLED_MENU_LAYOUT_LIST);
	if (ret < 0) {
		return ret;
	}

	for (size_t i = 0; i < ARRAY_SIZE(modules); i++) {
		lv_obj_t *row;

		ret = modules[i]->create(&home);
		if (ret < 0) {
			LOG_ERR("%s: screen setup failed (%d)", modules[i]->label, ret);
			return ret;
		}

		row = oled_menu_row_add(&home, modules[i]->label, on_open_module,
					(void *)modules[i]);

		/* Hardware that did not probe keeps its row and its screen, but
		 * the row is struck through: on a board with parts left
		 * unpopulated that is the most useful thing the menu can say.
		 */
		if (modules[i]->present != NULL && !modules[i]->present()) {
			oled_menu_row_set_absent(row, true);
			LOG_INF("%s: not present", modules[i]->label);
		}
	}

	lv_timer_create(refresh_timer_cb, REFRESH_PERIOD_MS, NULL);
	lv_timer_create(clock_timer_cb, CLOCK_PERIOD_MS, NULL);

	oled_menu_show(&home);

	return 0;
}
```

## src/mod_about.c
```c
/**
 * @file mod_about.c
 * @brief Build identification: board revision, Zephyr and LVGL versions.
 *
 * @copyright Copyright (c) Centro de Inovacao EDGE
 */

#include "module.h"

#include <zephyr/logging/log.h>
#include <zephyr/sys/util.h>
#include <zephyr/version.h>

LOG_MODULE_REGISTER(mod_about, LOG_LEVEL_INF);

static struct oled_menu_screen screen;

static int create(const struct oled_menu_screen *home)
{
	lv_obj_t *text;
	int ret = oled_menu_screen_create(&screen, "About", OLED_MENU_LAYOUT_PANEL);

	if (ret < 0) {
		return ret;
	}

	text = oled_menu_label_add(
		&screen, CONFIG_BOARD_TARGET
		"\n"
		"Zephyr " KERNEL_VERSION_STRING "\n"
		"LVGL " STRINGIFY(LVGL_VERSION_MAJOR) "." STRINGIFY(
							  LVGL_VERSION_MINOR));
	lv_obj_set_style_pad_bottom(text, 4, LV_PART_MAIN);

	oled_menu_back_row_add(&screen, home);

	return 0;
}

static const struct oled_menu_screen *get_screen(void)
{
	return &screen;
}

const struct bringup_module module_about = {
	.label = "About",
	.create = create,
	.screen = get_screen,
	.refresh = NULL,
};
```

## src/mod_accel.c
```c
/**
 * @file mod_accel.c
 * @brief The BMI323 accelerometer / gyroscope on spi1.
 *
 *        Not populated on every P2 board; like the temperature sensor, an
 *        absent part is reported rather than hidden. The BMI323 driver takes
 *        int-gpios as mandatory, so INT1 (GPIO15) has to be wired for it to
 *        probe at all.
 *
 * @copyright Copyright (c) Centro de Inovacao EDGE
 */

#include "module.h"

#include <errno.h>
#include <stdint.h>
#include <stdlib.h>

#include <zephyr/device.h>
#include <zephyr/devicetree.h>
#include <zephyr/drivers/gpio.h>
#include <zephyr/drivers/sensor.h>
#include <stdbool.h>
#include <zephyr/logging/log.h>

LOG_MODULE_REGISTER(mod_accel, LOG_LEVEL_INF);

static const struct device *const sensor = DEVICE_DT_GET(DT_NODELABEL(bmi323));
static const struct gpio_dt_spec int2 = GPIO_DT_SPEC_GET(DT_NODELABEL(int2), gpios);

static struct oled_menu_screen screen;
static lv_obj_t *axes;
static lv_obj_t *interrupt;

static void refresh(void)
{
	int ret;
	struct sensor_value values[3];

	if (!device_is_ready(sensor)) {
		lv_label_set_text(axes, "not fitted");
	} else {
		ret = sensor_sample_fetch_chan(sensor, SENSOR_CHAN_ACCEL_XYZ);
		if (ret < 0) {
			lv_label_set_text_fmt(axes, "fetch %d", ret);
		} else {
			ret = sensor_channel_get(sensor, SENSOR_CHAN_ACCEL_XYZ, values);
			if (ret < 0) {
				lv_label_set_text_fmt(axes, "get %d", ret);
			} else {
				/* m/s^2 to two decimals, one axis per line: three
				 * numbers do not fit across 16 characters.
				 */
				lv_label_set_text_fmt(axes, "X %5d.%02d\nY %5d.%02d\nZ %5d.%02d",
						      values[0].val1, abs(values[0].val2) / 10000,
						      values[1].val1, abs(values[1].val2) / 10000,
						      values[2].val1, abs(values[2].val2) / 10000);
			}
		}
	}

	if (!gpio_is_ready_dt(&int2)) {
		lv_label_set_text(interrupt, "INT2 n/a");
		return;
	}

	lv_label_set_text_fmt(interrupt, "INT2 %s", gpio_pin_get_dt(&int2) > 0 ? "ACTIVE" : "idle");
}

static int create(const struct oled_menu_screen *home)
{
	int ret = oled_menu_screen_create(&screen, "Accel", OLED_MENU_LAYOUT_LIST);

	if (ret < 0) {
		return ret;
	}

	if (!device_is_ready(sensor)) {
		LOG_WRN("%s did not probe: not fitted on this board?", sensor->name);
	}

	if (gpio_is_ready_dt(&int2)) {
		ret = gpio_pin_configure_dt(&int2, GPIO_INPUT);
		if (ret < 0) {
			LOG_ERR("INT2 configure failed (%d)", ret);
		}
	}

	axes = oled_menu_label_add(&screen, "X --\nY --\nZ --");
	interrupt = oled_menu_label_add(&screen, "INT2 idle");

	oled_menu_back_row_add(&screen, home);

	return 0;
}

static bool present(void)
{
	return device_is_ready(sensor);
}

static const struct oled_menu_screen *get_screen(void)
{
	return &screen;
}

const struct bringup_module module_accel = {
	.label = "Accelerometer",
	.create = create,
	.screen = get_screen,
	.refresh = refresh,
	.present = present,
};
```

## src/mod_analog.c
```c
/**
 * @file mod_analog.c
 * @brief The three analog inputs: potentiometer, LDR and microphone.
 *
 *        All three are plain ADC channels described in the board devicetree
 *        (channels 1, 4 and 0 respectively). Rather than crowding them onto
 *        one screen, the module row opens a submenu naming each input, and
 *        each input then gets a screen to itself: the reading in counts, as a
 *        percentage of full scale, and a bar.
 *
 * @copyright Copyright (c) Centro de Inovacao EDGE
 */

#include "module.h"

#include <errno.h>
#include <stdbool.h>
#include <stddef.h>
#include <stdint.h>

#include <zephyr/device.h>
#include <zephyr/devicetree.h>
#include <zephyr/drivers/adc.h>
#include <zephyr/logging/log.h>

LOG_MODULE_REGISTER(mod_analog, LOG_LEVEL_INF);

/* Matches zephyr,resolution on the channel nodes. */
#define RESOLUTION_BITS 12
#define FULL_SCALE      ((1 << RESOLUTION_BITS) - 1)

static const struct device *const adc = DEVICE_DT_GET(DT_NODELABEL(adc));

/* Samples taken per refresh for an input read as a waveform rather than a
 * level. 128 reads take a couple of milliseconds, which is short enough to sit
 * inside the LVGL timer callback and long enough to catch a few cycles of
 * anything audible.
 */
#define BURST_SAMPLES 128

/** One analog input and the widgets showing it. */
struct analog_input {
	/** Submenu row text. Up to OLED_MENU_COLUMNS characters. */
	const char *label;
	/** Title bar text. Shorter, because the clock shares the bar. */
	const char *title;
	/** The ADC channel, straight from the devicetree. */
	const struct adc_channel_cfg channel;
	/** Full-scale value for the bar. */
	int32_t bar_max;
	/**
	 * @brief Report peak-to-peak over a burst instead of a single level.
	 *
	 * A microphone is an AC signal: one reading every refresh says nothing
	 * about it, however often it is taken.
	 */
	bool waveform;
	struct oled_menu_screen screen;
	lv_obj_t *value;
	lv_obj_t *bar;
	bool ready;
};

static struct analog_input inputs[] = {
	{
		.label = "Potentiometer",
		.title = "Pot",
		.channel = ADC_CHANNEL_CFG_DT(DT_NODELABEL(potentiometer)),
		.bar_max = FULL_SCALE,
	},
	{
		.label = "LDR (light)",
		.title = "LDR",
		.channel = ADC_CHANNEL_CFG_DT(DT_NODELABEL(ldr_adc)),
		.bar_max = FULL_SCALE,
	},
	{
		.label = "Microphone",
		.title = "Mic",
		.channel = ADC_CHANNEL_CFG_DT(DT_NODELABEL(microphone_adc)),
		/* Peak-to-peak, not absolute level, so a much smaller span. */
		.bar_max = 1024,
		.waveform = true,
	},
};

static struct oled_menu_screen submenu;

static void on_open_input(lv_event_t *event)
{
	oled_menu_show(&((struct analog_input *)lv_event_get_user_data(event))->screen);
}

static void input_refresh(struct analog_input *input)
{
	int ret;
	uint16_t sample = 0;
	uint16_t lowest = UINT16_MAX;
	uint16_t highest = 0;
	uint32_t total = 0;
	uint16_t count = input->waveform ? BURST_SAMPLES : 1U;
	struct adc_sequence sequence = {
		.buffer = &sample,
		.buffer_size = sizeof(sample),
		.channels = BIT(input->channel.channel_id),
		.resolution = RESOLUTION_BITS,
	};

	if (!input->ready) {
		lv_label_set_text(input->value, "not ready");
		return;
	}

	for (uint16_t i = 0; i < count; i++) {
		ret = adc_read(adc, &sequence);
		if (ret < 0) {
			lv_label_set_text_fmt(input->value, "error %d", ret);
			return;
		}

		lowest = MIN(lowest, sample);
		highest = MAX(highest, sample);
		total += sample;
	}

	if (input->waveform) {
		/* Peak-to-peak is the figure that moves when there is sound;
		 * the mean is shown too because it says where the input is
		 * sitting, which is the first thing to check if pp stays at 0.
		 */
		lv_label_set_text_fmt(input->value, "pp   %u\nmean %u\nmin %u max %u",
				      (unsigned int)(highest - lowest),
				      (unsigned int)(total / count), (unsigned int)lowest,
				      (unsigned int)highest);
		lv_bar_set_value(input->bar, highest - lowest, LV_ANIM_OFF);
		return;
	}

	/* Counts as well as the percentage: a bring-up test wants the raw
	 * number, and the percentage is what the bar shows.
	 */
	lv_label_set_text_fmt(input->value, "%u counts\n%u.%u %%", (unsigned int)sample,
			      (unsigned int)((sample * 1000U) / FULL_SCALE) / 10U,
			      (unsigned int)((sample * 1000U) / FULL_SCALE) % 10U);
	lv_bar_set_value(input->bar, sample, LV_ANIM_OFF);
}

static void refresh(void)
{
	for (size_t i = 0; i < ARRAY_SIZE(inputs); i++) {
		if (oled_menu_is_active(&inputs[i].screen)) {
			input_refresh(&inputs[i]);
			return;
		}
	}
}

static int create(const struct oled_menu_screen *home)
{
	int ret = oled_menu_screen_create(&submenu, "Analog in", OLED_MENU_LAYOUT_LIST);

	if (ret < 0) {
		return ret;
	}

	if (!device_is_ready(adc)) {
		LOG_WRN("%s is not ready", adc->name);
	}

	for (size_t i = 0; i < ARRAY_SIZE(inputs); i++) {
		struct analog_input *input = &inputs[i];

		if (device_is_ready(adc)) {
			ret = adc_channel_setup(adc, &input->channel);
			if (ret < 0) {
				LOG_ERR("%s: channel %u setup failed (%d)", input->label,
					input->channel.channel_id, ret);
			} else {
				input->ready = true;
			}
		}

		ret = oled_menu_screen_create(&input->screen, input->title, OLED_MENU_LAYOUT_PANEL);
		if (ret < 0) {
			return ret;
		}

		input->value = oled_menu_label_add(&input->screen, "--");
		lv_obj_set_style_pad_bottom(input->value, 3, LV_PART_MAIN);
		input->bar = oled_menu_bar_add(&input->screen, 0, input->bar_max);
		oled_menu_back_row_add(&input->screen, &submenu);

		oled_menu_row_add(&submenu, input->label, on_open_input, input);
	}

	oled_menu_back_row_add(&submenu, home);

	return 0;
}

static const struct oled_menu_screen *get_screen(void)
{
	return &submenu;
}

static bool is_showing(void)
{
	if (oled_menu_is_active(&submenu)) {
		return true;
	}

	for (size_t i = 0; i < ARRAY_SIZE(inputs); i++) {
		if (oled_menu_is_active(&inputs[i].screen)) {
			return true;
		}
	}

	return false;
}

static bool present(void)
{
	return device_is_ready(adc);
}

const struct bringup_module module_analog = {
	.label = "Analog in",
	.create = create,
	.screen = get_screen,
	.is_showing = is_showing,
	.refresh = refresh,
	.present = present,
};
```

## src/mod_buttons.c
```c
/**
 * @file mod_buttons.c
 * @brief The four user buttons and the rotary encoder.
 *
 *        All five signals already reach LVGL as Zephyr input events, so this
 *        screen subscribes to the same stream rather than reading the GPIOs:
 *        what it shows is exactly what the input subsystem is reporting. The
 *        encoder's own button is LVGL's select, so pressing it here also
 *        activates the focused row -- that is the test.
 *
 * @copyright Copyright (c) Centro de Inovacao EDGE
 */

#include "module.h"

#include <stdbool.h>
#include <stddef.h>
#include <stdint.h>

#include <zephyr/input/input.h>
#include <zephyr/logging/log.h>

LOG_MODULE_REGISTER(mod_buttons, LOG_LEVEL_INF);

#define BUTTON_COUNT 4

static const uint16_t button_codes[BUTTON_COUNT] = {
	INPUT_BTN_0,
	INPUT_BTN_1,
	INPUT_BTN_2,
	INPUT_BTN_3,
};

static struct oled_menu_screen screen;
static lv_obj_t *button_label;
static lv_obj_t *encoder_label;

/* Written from the input callback, read by the LVGL refresh. Both run in
 * thread context and each value is a single word, so no lock is needed.
 */
static volatile bool button_state[BUTTON_COUNT];
static volatile bool encoder_pressed;
static volatile int32_t encoder_position;
static volatile uint32_t encoder_edges;

static void on_input_event(struct input_event *event, void *user_data)
{
	ARG_UNUSED(user_data);

	if (event->type == INPUT_EV_REL && event->code == INPUT_REL_WHEEL) {
		encoder_position += event->value;
		encoder_edges++;
		return;
	}

	if (event->type != INPUT_EV_KEY) {
		return;
	}

	if (event->code == INPUT_KEY_ENTER) {
		encoder_pressed = (event->value != 0);
		return;
	}

	for (size_t i = 0; i < BUTTON_COUNT; i++) {
		if (event->code == button_codes[i]) {
			button_state[i] = (event->value != 0);
			return;
		}
	}
}

/* NULL device: every input device in the system, which is what lets one
 * callback cover the buttons (gpio-keys) and the encoder (gpio-qdec) at once.
 */
INPUT_CALLBACK_DEFINE(NULL, on_input_event, NULL);

static void refresh(void)
{
	char marks[BUTTON_COUNT + 1];

	for (size_t i = 0; i < BUTTON_COUNT; i++) {
		marks[i] = button_state[i] ? '*' : '-';
	}
	marks[BUTTON_COUNT] = '\0';

	lv_label_set_text_fmt(button_label, "BTN 0123\n    %s", marks);
	lv_label_set_text_fmt(encoder_label, "ENC %+ld  n=%u\nPRESS  %c", (long)encoder_position,
			      (unsigned int)encoder_edges, encoder_pressed ? '*' : '-');
}

static void on_reset(lv_event_t *event)
{
	ARG_UNUSED(event);

	encoder_position = 0;
	encoder_edges = 0;
}

static int create(const struct oled_menu_screen *home)
{
	int ret = oled_menu_screen_create(&screen, "Buttons/Enc", OLED_MENU_LAYOUT_LIST);

	if (ret < 0) {
		return ret;
	}

	button_label = oled_menu_label_add(&screen, "BTN 0123\n    ----");
	encoder_label = oled_menu_label_add(&screen, "ENC +0  n=0\nPRESS  -");

	oled_menu_row_add(&screen, "Reset count", on_reset, NULL);
	oled_menu_back_row_add(&screen, home);

	return 0;
}

static const struct oled_menu_screen *get_screen(void)
{
	return &screen;
}

const struct bringup_module module_buttons = {
	.label = "Buttons/Enc",
	.create = create,
	.screen = get_screen,
	.refresh = refresh,
};
```

## src/mod_buzzer.c
```c
/**
 * @file mod_buzzer.c
 * @brief The piezo buzzer on PWM slice 8 (GPIO32, through Q7).
 *
 *        Slice 8 runs with divider 255, so the PWM clock is clk_sys/255 and
 *        the 16-bit counter reaches down to about 9 Hz -- the tones below are
 *        all comfortably inside that range.
 *
 * @copyright Copyright (c) Centro de Inovacao EDGE
 */

#include "module.h"

#include <errno.h>
#include <stddef.h>
#include <stdint.h>

#include <zephyr/devicetree.h>
#include <zephyr/drivers/pwm.h>
#include <stdbool.h>
#include <zephyr/logging/log.h>

LOG_MODULE_REGISTER(mod_buzzer, LOG_LEVEL_INF);

static const struct pwm_dt_spec buzzer = PWM_DT_SPEC_GET(DT_ALIAS(pwm_buzzer));

static struct oled_menu_screen screen;
static lv_obj_t *status;

static const uint32_t tones_hz[] = {440, 880, 1760, 3520};
static const char *const tone_names[] = {"440 Hz", "880 Hz", "1760 Hz", "3520 Hz"};

static void tone_set(uint32_t hz)
{
	int ret;
	uint32_t period_ns;

	if (!pwm_is_ready_dt(&buzzer)) {
		lv_label_set_text(status, "not ready");
		return;
	}

	if (hz == 0) {
		/* Zero pulse rather than zero period: a zero period is not a
		 * valid PWM setting.
		 */
		ret = pwm_set_dt(&buzzer, buzzer.period, 0);
		if (ret < 0) {
			LOG_ERR("stop failed (%d)", ret);
			lv_label_set_text_fmt(status, "error %d", ret);
			return;
		}

		lv_label_set_text(status, "silent");
		return;
	}

	period_ns = NSEC_PER_SEC / hz;

	/* Square wave: the piezo is loudest at 50% duty. */
	ret = pwm_set_dt(&buzzer, period_ns, period_ns / 2U);
	if (ret < 0) {
		LOG_ERR("%u Hz failed (%d)", hz, ret);
		lv_label_set_text_fmt(status, "error %d", ret);
		return;
	}

	lv_label_set_text_fmt(status, "%u Hz", hz);
}

static void on_tone(lv_event_t *event)
{
	tone_set(tones_hz[(size_t)(uintptr_t)lv_event_get_user_data(event)]);
}

static void on_silence(lv_event_t *event)
{
	ARG_UNUSED(event);

	tone_set(0);
}

/** Short rising sweep: one press, and a working buzzer is unmistakable. */
static void on_sweep(lv_event_t *event)
{
	ARG_UNUSED(event);

	for (size_t i = 0; i < ARRAY_SIZE(tones_hz); i++) {
		tone_set(tones_hz[i]);
		k_msleep(150);
	}

	tone_set(0);
	lv_label_set_text(status, "sweep done");
}

static int create(const struct oled_menu_screen *home)
{
	int ret = oled_menu_screen_create(&screen, "Buzzer", OLED_MENU_LAYOUT_LIST);

	if (ret < 0) {
		return ret;
	}

	if (!pwm_is_ready_dt(&buzzer)) {
		LOG_WRN("PWM for the buzzer is not ready");
	}

	status = oled_menu_label_add(&screen, pwm_is_ready_dt(&buzzer) ? "silent" : "not ready");

	for (size_t i = 0; i < ARRAY_SIZE(tones_hz); i++) {
		oled_menu_row_add(&screen, tone_names[i], on_tone, (void *)(uintptr_t)i);
	}

	oled_menu_row_add(&screen, "Sweep", on_sweep, NULL);
	oled_menu_row_add(&screen, "Silence", on_silence, NULL);
	oled_menu_back_row_add(&screen, home);

	return 0;
}

static bool present(void)
{
	return pwm_is_ready_dt(&buzzer);
}

static const struct oled_menu_screen *get_screen(void)
{
	return &screen;
}

const struct bringup_module module_buzzer = {
	.label = "Buzzer",
	.create = create,
	.screen = get_screen,
	.refresh = NULL,
	.present = present,
};
```

## src/mod_display.c
```c
/**
 * @file mod_display.c
 * @brief The OLED itself.
 *
 *        Reading this screen already proves the panel works, so what is left
 *        to exercise is the parts a static image does not touch: the contrast
 *        register, hardware blanking, and both pixel polarities. The reported
 *        geometry comes from the driver rather than from constants here, so a
 *        mis-described panel shows up as wrong numbers.
 *
 * @copyright Copyright (c) Centro de Inovacao EDGE
 */

#include "module.h"

#include <errno.h>
#include <stddef.h>
#include <stdint.h>

#include <zephyr/device.h>
#include <zephyr/devicetree.h>
#include <zephyr/drivers/display.h>
#include <zephyr/kernel.h>
#include <zephyr/logging/log.h>

LOG_MODULE_REGISTER(mod_display, LOG_LEVEL_INF);

#define BLANK_MS 700

static const struct device *const display = DEVICE_DT_GET(DT_CHOSEN(zephyr_display));

static const uint8_t contrasts[] = {255, 128, 64, 16};

static struct oled_menu_screen screen;
static lv_obj_t *info;
static lv_obj_t *status;
static size_t contrast_index;

static void on_contrast(lv_event_t *event)
{
	int ret;

	ARG_UNUSED(event);

	contrast_index = (contrast_index + 1U) % ARRAY_SIZE(contrasts);

	ret = display_set_contrast(display, contrasts[contrast_index]);
	if (ret < 0) {
		lv_label_set_text_fmt(status, "contrast %d", ret);
		return;
	}

	lv_label_set_text_fmt(status, "contrast %u", (unsigned int)contrasts[contrast_index]);
}

/** Blank and unblank: exercises the panel-on/off command path. */
static void on_blank(lv_event_t *event)
{
	int ret;

	ARG_UNUSED(event);

	ret = display_blanking_on(display);
	if (ret < 0) {
		lv_label_set_text_fmt(status, "blank %d", ret);
		return;
	}

	k_msleep(BLANK_MS);

	ret = display_blanking_off(display);
	if (ret < 0) {
		lv_label_set_text_fmt(status, "unblank %d", ret);
		return;
	}

	lv_label_set_text(status, "blank ok");
}

static int create(const struct oled_menu_screen *home)
{
	struct display_capabilities caps;
	int ret = oled_menu_screen_create(&screen, "Display", OLED_MENU_LAYOUT_LIST);

	if (ret < 0) {
		return ret;
	}

	display_get_capabilities(display, &caps);

	info = oled_menu_label_add(&screen, "");
	lv_label_set_text_fmt(info, "%ux%u pf=%u", (unsigned int)caps.x_resolution,
			      (unsigned int)caps.y_resolution,
			      (unsigned int)caps.current_pixel_format);

	status = oled_menu_label_add(&screen, "contrast 128");

	oled_menu_row_add(&screen, "Contrast next", on_contrast, NULL);
	oled_menu_row_add(&screen, "Blank test", on_blank, NULL);
	oled_menu_back_row_add(&screen, home);

	return 0;
}

static const struct oled_menu_screen *get_screen(void)
{
	return &screen;
}

const struct bringup_module module_display = {
	.label = "Display",
	.create = create,
	.screen = get_screen,
	.refresh = NULL,
};
```
